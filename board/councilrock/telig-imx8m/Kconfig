## board/councilrock/telig-imx8m/Kconfig
```kconfig
if TARGET_IMX8MM_TELIG

config SYS_BOARD
	default "telig-imx8m"

config SYS_VENDOR
	default "councilrock"

config SYS_CONFIG_NAME
	default "imx8mm_telig"

endif
```
